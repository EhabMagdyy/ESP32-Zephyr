## CMakeLists.txt
```
cmake_minimum_required(VERSION 3.20.0)
find_package(Zephyr REQUIRED HINTS $ENV{ZEPHYR_BASE})
project(wifiHttp)

target_sources(app PRIVATE
    src/main.c
    src/http_get.c
    src/ping.c
)

target_include_directories(app PRIVATE inc)
```

## prj.conf
```kconfig
CONFIG_ESP32_USE_UNSUPPORTED_REVISION=y

CONFIG_WIFI=y
CONFIG_INIT_STACKS=y
CONFIG_NET_L2_WIFI_MGMT=y

CONFIG_NETWORKING=y
CONFIG_NET_IPV4=y
CONFIG_NET_IPV6=y
CONFIG_NET_UDP=y
CONFIG_NET_TCP=y
CONFIG_DNS_RESOLVER=y
CONFIG_DNS_RESOLVER_AI_MAX_ENTRIES=10

CONFIG_NET_SOCKETS=y
CONFIG_HTTP_CLIENT=y

# Use DHCP for IPv4
CONFIG_NET_DHCPV4=y

# Or assign a static IP address (useful for testing)
# Following line must be enabled, otherwise WiFi connection fails with -1.
CONFIG_NET_CONFIG_SETTINGS=y
# Add CONFIG_INIT_TIMEOUT to prevent 30 second timeout when starting:
# [00:00:30.600,250] <err> net_config: Timeout while waiting network interface
# [00:00:30.600,250] <err> net_config: Network initialization failed (-115)
CONFIG_NET_CONFIG_INIT_TIMEOUT=1
#CONFIG_NET_CONFIG_NEED_IPV4=y
#CONFIG_NET_CONFIG_MY_IPV4_ADDR="192.168.0.12"
#CONFIG_NET_CONFIG_MY_IPV4_GW="192.168.0.254"
#CONFIG_NET_CONFIG_NEED_IPV6=y
#CONFIG_NET_CONFIG_MY_IPV6_ADDR="fe80::100"

# Enabling logging can be helpful for debugging
#CONFIG_NET_LOG=y
#CONFIG_WIFI_LOG_LEVEL_ERR=y
#CONFIG_NET_IPV6_LOG_LEVEL_DBG=y

CONFIG_NET_TX_STACK_SIZE=2048
CONFIG_NET_RX_STACK_SIZE=2048

CONFIG_NET_PKT_RX_COUNT=10
CONFIG_NET_PKT_TX_COUNT=10

CONFIG_NET_BUF_RX_COUNT=20
CONFIG_NET_BUF_TX_COUNT=20

CONFIG_NET_MAX_CONTEXTS=10

# Added to prevent error with missing #include <ethernet/eth_stats.h> for esp_wifi_drv.c
# Adding this line will cause CMAKE Warning: No SOURCES given to Zephyr library: drivers__ethernet
# Just ignore.
CONFIG_NET_L2_ETHERNET=y

CONFIG_PRINTK_BUFFER_SIZE=2048
```

## src/main.c
```c
#include <zephyr/kernel.h>
#include <zephyr/net/net_if.h>
#include <zephyr/net/wifi_mgmt.h>
#include <zephyr/net/net_event.h>
#include <errno.h>
#include "http_get.h"
#include "ping.h"

#define SSID "ITI_Students"
#define PSK "ITI_2@24"

// binary semaphore to signal when WiFi is connected
static K_SEM_DEFINE(wifi_connected, 0, 1);
// binary semaphore to signal when an IPv4 address is obtained
static K_SEM_DEFINE(ipv4_address_obtained, 0, 1);

static struct net_mgmt_event_callback wifi_cb;
static struct net_mgmt_event_callback ipv4_cb;

static void handle_wifi_connect_result(struct net_mgmt_event_callback *cb){
    const struct wifi_status *status = (const struct wifi_status *)cb->info;

    if(status->status){
        printk("Connection request failed (%d)\n", status->status);
    }
    else{
        printk("Connected\n");
        k_sem_give(&wifi_connected);
    }
}

static void handle_wifi_disconnect_result(struct net_mgmt_event_callback *cb){
    const struct wifi_status *status = (const struct wifi_status *)cb->info;

    if(status->status){
        printk("Disconnection request (%d)\n", status->status);
    }
    else{
        printk("Disconnected\n");
        k_sem_take(&wifi_connected, K_NO_WAIT);
    }
}

static void handle_ipv4_result(struct net_if *iface){
    int i = 0;

    for(i = 0; i < NET_IF_MAX_IPV4_ADDR; i++){

        char buf[NET_IPV4_ADDR_LEN];

        if(iface->config.ip.ipv4->unicast[i].ipv4.addr_type != NET_ADDR_DHCP){
            continue;
        }

        printk("IPv4 address: %s\n", net_addr_ntop(AF_INET, &iface->config.ip.ipv4->unicast[i].ipv4.address.in_addr, buf, sizeof(buf)));
        printk("Subnet: %s\n", net_addr_ntop(AF_INET, &iface->config.ip.ipv4->unicast[i].netmask, buf, sizeof(buf)));
        printk("Router: %s\n", net_addr_ntop(AF_INET, &iface->config.ip.ipv4->gw, buf, sizeof(buf)));
    }

    k_sem_give(&ipv4_address_obtained);
}

static void wifi_mgmt_event_handler(struct net_mgmt_event_callback *cb, uint64_t mgmt_event, struct net_if *iface){
    switch (mgmt_event){

        case NET_EVENT_WIFI_CONNECT_RESULT:
            handle_wifi_connect_result(cb);
            break;

        case NET_EVENT_WIFI_DISCONNECT_RESULT:
            handle_wifi_disconnect_result(cb);
            break;

        case NET_EVENT_IPV4_ADDR_ADD:
            handle_ipv4_result(iface);
            break;

        default:
            break;
    }
}

void wifi_connect(void){
    struct net_if *iface = net_if_get_default();

    struct wifi_connect_req_params wifi_params = {0};

    wifi_params.ssid = SSID;
    wifi_params.psk = PSK;
    wifi_params.ssid_length = strlen(SSID);
    wifi_params.psk_length = strlen(PSK);
    wifi_params.channel = WIFI_CHANNEL_ANY;
    wifi_params.security = WIFI_SECURITY_TYPE_PSK;
    wifi_params.band = WIFI_FREQ_BAND_2_4_GHZ; 
    wifi_params.mfp = WIFI_MFP_OPTIONAL;

    printk("Connecting to SSID: %s\n", wifi_params.ssid);

    if(net_mgmt(NET_REQUEST_WIFI_CONNECT, iface, &wifi_params, sizeof(struct wifi_connect_req_params))){
        printk("WiFi Connection Request Failed\n");
    }
}

void wifi_status(void){
    struct net_if *iface = net_if_get_default();
    
    struct wifi_iface_status status = {0};

    if(net_mgmt(NET_REQUEST_WIFI_IFACE_STATUS, iface, &status,	sizeof(struct wifi_iface_status))){
        printk("WiFi Status Request Failed\n");
    }

    printk("\n");

    if(status.state >= WIFI_STATE_ASSOCIATED){
        printk("SSID: %-32s\n", status.ssid);
        printk("Band: %s\n", wifi_band_txt(status.band));
        printk("Channel: %d\n", status.channel);
        printk("Security: %s\n", wifi_security_txt(status.security));
        printk("RSSI: %d\n", status.rssi);
    }
}

void wifi_disconnect(void){
    struct net_if *iface = net_if_get_default();

    if(net_mgmt(NET_REQUEST_WIFI_DISCONNECT, iface, NULL, 0)){
        printk("WiFi Disconnection Request Failed\n");
    }
}

int main(void){
    printk("WiFi Example\nBoard: %s\n", CONFIG_BOARD);

    net_mgmt_init_event_callback(&wifi_cb, wifi_mgmt_event_handler, NET_EVENT_WIFI_CONNECT_RESULT | NET_EVENT_WIFI_DISCONNECT_RESULT);

    net_mgmt_init_event_callback(&ipv4_cb, wifi_mgmt_event_handler, NET_EVENT_IPV4_ADDR_ADD);

    net_mgmt_add_event_callback(&wifi_cb);
    net_mgmt_add_event_callback(&ipv4_cb);

    wifi_connect();
    k_sem_take(&wifi_connected, K_FOREVER);
    wifi_status();
    k_sem_take(&ipv4_address_obtained, K_FOREVER);
    printk("Ready...\n\n");

    struct zsock_addrinfo *res;
    printk("Looking up google...\n");
    if(nslookup("google.com", &res) == 1){
        // 1. Get the IP string from the DNS result to use for Ping
        char myIPv4[INET_ADDRSTRLEN];
        addrinfo_results(&res, myIPv4);

        // 2. Now Ping the resolved IP
        ping(myIPv4, 4);

        // 3. Connect and HTTP GET
        int sock = connect_socket(&res, 80);
        if(sock >= 0){
            http_get(sock, "google.com", "/");
            zsock_close(sock);
        }
        // Free the DNS results memory
        zsock_freeaddrinfo(res);
    }

    while(1){
        k_sleep(K_FOREVER);
    }

    return(0);
}
```

## inc/http_get.h
```c
#include <stdio.h>
#include <stdlib.h>
#include <zephyr/net/socket.h>

uint8_t nslookup(const char * hostname, struct zsock_addrinfo **results);
void addrinfo_results(struct zsock_addrinfo **results, char* myIPv4);
void http_get(int sock, char * hostname, char * url);
int connect_socket(struct zsock_addrinfo **results, uint16_t port);
```

## src/http_get.c
```c
#include <stdio.h>
#include <stdlib.h>
#include <zephyr/net/socket.h>
#include <zephyr/kernel.h>
#include <zephyr/net/http/client.h>

uint8_t nslookup(const char * hostname, struct zsock_addrinfo **results){
	int err;
	
	struct zsock_addrinfo hints = {
		//.ai_family = AF_INET,     // Allow IPv4 Address
		.ai_family = AF_UNSPEC,		// Allow IPv4 or IPv6	
		.ai_socktype = SOCK_STREAM,
	};

	err = zsock_getaddrinfo(hostname, NULL, &hints, (struct zsock_addrinfo **) results);
	if(err){
		printf("getaddrinfo() failed, err %d\n", errno);
		return 0;
	}
	return 1;
}

void addrinfo_results(struct zsock_addrinfo **results, char* myIPv4){
	char ipv4[INET_ADDRSTRLEN];
	char ipv6[INET6_ADDRSTRLEN];
	struct sockaddr_in *sa;
	struct sockaddr_in6 *sa6;
	struct zsock_addrinfo *rp;
	
	for(rp = *results; rp != NULL; rp = rp->ai_next){
		if(rp->ai_addr->sa_family == AF_INET){
			// IPv4 Address
			sa = (struct sockaddr_in *) rp->ai_addr;
			zsock_inet_ntop(AF_INET, &sa->sin_addr, ipv4, INET_ADDRSTRLEN);
			printf("IPv4: %s\n", ipv4);
			strcpy(myIPv4, ipv4);
		}
		if(rp->ai_addr->sa_family == AF_INET6){
			// IPv6 Address
			sa6 = (struct sockaddr_in6 *) rp->ai_addr;
			zsock_inet_ntop(AF_INET6, &sa6->sin6_addr, ipv6, INET6_ADDRSTRLEN);
			printf("IPv6: %s\n", ipv6);
		}
	}
}

int connect_socket(struct zsock_addrinfo **results, uint16_t port){
	int sock;
	int ret;
	struct zsock_addrinfo *rp;
	struct sockaddr_in6 *sa6;

	// Create IPv6 Socket
	sock = zsock_socket(AF_INET6, SOCK_STREAM, IPPROTO_TCP);
	if (sock < 0) {
		printk("Error creating IPv6 socket\n");
		return(-1);
	}

	// Iterate through IPv6 addresses until we get a successful connection
	for (rp = *results; rp != NULL; rp = rp->ai_next) {
		if (rp->ai_addr->sa_family == AF_INET6) {
			// IPv6 Address
			sa6 = (struct sockaddr_in6 *) rp->ai_addr;
			sa6->sin6_port = htons(port);
			
			char ipv6[INET6_ADDRSTRLEN];
			zsock_inet_ntop(AF_INET6, &sa6->sin6_addr, ipv6, INET6_ADDRSTRLEN);
			printk("Connecting to %s:%d ", ipv6, port);

			ret = zsock_connect(sock, (struct sockaddr *) sa6, sizeof(struct sockaddr_in));
			if (ret == 0) {
				printk("Success\r\n");
				return(sock);
			} else {
				printk("Failure (%d)\r\n", ret);
			}
		}
	}
	// Close IPv6 Socket
	zsock_close(sock);

	// Now try IPv4 Addresses
	struct sockaddr_in *sa;

	// Create IPv4 Socket
	sock = zsock_socket(AF_INET, SOCK_STREAM, IPPROTO_TCP);
	if (sock < 0) {
		printk("Error creating IPv4 socket\n");
		return(-1);
	}
	
	// Iterate through IPv4 addresses until we get a successful connection
	for (rp = *results; rp != NULL; rp = rp->ai_next) {
		if (rp->ai_addr->sa_family == AF_INET) {
			// IPv4 Address
			sa = (struct sockaddr_in *) rp->ai_addr;
			sa->sin_port = htons(port);

			char ipv4[INET_ADDRSTRLEN];
			zsock_inet_ntop(AF_INET, &sa->sin_addr, ipv4, INET_ADDRSTRLEN);
			printk("Connecting to %s:%d ", ipv4, port);

			ret = zsock_connect(sock, (struct sockaddr *) sa, sizeof(struct sockaddr_in));
			if (ret == 0) {
				printk("Success\r\n");
				return(sock);
			} else {
				printk("Failure (%d)\r\n", ret);
			}
		}
	}
	
	return(0);
}

static void http_response_cb(struct http_response *rsp, enum http_final_call final_data, void *user_data){
	if (final_data == HTTP_DATA_MORE) {
		//printk("Partial data received (%zd bytes)\n", rsp->data_len);
	} 
	else if (final_data == HTTP_DATA_FINAL) {
		//printk("All the data received (%zd bytes)\n", rsp->data_len);
	}

	//printk("Bytes Recv %zd\n", rsp->data_len);
	//printk("Response status %s\n", rsp->http_status);
	//printk("Recv Buffer Length %zd\n", rsp->recv_buf_len);
	printk("%.*s", rsp->data_len, rsp->recv_buf);
}

void http_get(int sock, char * hostname, char * url)
{
	struct http_request req = { 0 };
	static uint8_t recv_buf[512];
	int ret;

	req.method = HTTP_GET;
	req.url = url;
	req.host = hostname;
	req.protocol = "HTTP/1.1";
	req.response = (void *)http_response_cb;
	req.recv_buf = recv_buf;
	req.recv_buf_len = sizeof(recv_buf);

	ret = http_client_req(sock, &req, 5000, NULL);
}
```

## src/ping.c
```c
#include <stdio.h>
#include <stdlib.h>
#include <zephyr/net/socket.h>
#include <zephyr/kernel.h>
#include <zephyr/net/icmp.h>
#include <zephyr/net/net_ip.h>
#include <zephyr/net/net_pkt.h>
#include <zephyr/net/net_if.h>

// The handler MUST return enum net_verdict and match this exact signature
enum net_verdict icmp_echo_reply_handler(
										struct net_icmp_ctx *ctx,
										struct net_pkt *pkt,
										struct net_icmp_ip_hdr *ip_hdr,
										struct net_icmp_hdr *icmp_hdr,
										void *user_data){
    printk("Ping reply received!\n");
    return NET_OK;
}

void ping(char* ipv4_addr, uint8_t count){
    int ret;
    struct net_icmp_ctx icmp_context;
    struct net_if *iface = net_if_get_default();
    struct sockaddr_in dst_addr;

    // 1. Parse the target address
    if (net_addr_pton(AF_INET, ipv4_addr, &dst_addr.sin_addr) < 0) {
        printk("Invalid IPv4 address\n");
        return;
    }
    dst_addr.sin_family = AF_INET;

    /* 2. Initialize context (Register the listener)
     * Arguments: context, family, type, code, handler 
     */
    ret = net_icmp_init_ctx(&icmp_context, 
                           AF_INET, 
                           NET_ICMPV4_ECHO_REPLY, 
                           0, 
                           icmp_echo_reply_handler);
    
    if (ret != 0) {
        printk("Failed to init ICMP context, err: %d\n", ret);
        return;
    }

    // 3. Send the echo requests in a loop 
    for (int i = 0; i < count; i++){
        printk("Sending Ping #%d to %s...\n", i + 1, ipv4_addr);
        
        ret = net_icmp_send_echo_request(&icmp_context,
                                        iface,
                                        (struct sockaddr *)&dst_addr,
                                        NULL, // No extra data
                                        NULL);// No extra user data
        
        if (ret != 0) {
            printk("Failed to send ping, err: %d\n", ret);
        }

        k_sleep(K_SECONDS(2));
    }

    // 4. Cleanup when finished
    net_icmp_cleanup_ctx(&icmp_context);
}
```
